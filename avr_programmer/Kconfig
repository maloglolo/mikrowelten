## avr_programmer/Kconfig
```kconfig
menu "AVR Programmer Configuration"

source "hal/Kconfig"
source "protocols/Kconfig"
source "programmer/Kconfig"

endmenu
```

## avr_programmer/components/programmer/Kconfig
```kconfig
menu "Programmer Options"

config AVR_PROGRAMMER_RX_BUFFER_SIZE
    int "RX Buffer Size"
    default 256
    help
      Size of the serial receive buffer

config AVR_PROGRAMMER_TX_BUFFER_SIZE
    int "TX Buffer Size"
    default 256
    help
      Size of the serial transmit buffer

endmenu
```

## avr_programmer/components/protocols/Kconfig
```kconfig
menu "Protocol Options"

config AVR_PROTOCOL_STK500V1
    bool "Enable STK500v1"
    default y
    help
      Include STK500v1 protocol support

config AVR_PROTOCOL_STK500V2
    bool "Enable STK500v2"
    default n
    help
      Include STK500v2 protocol support (not implemented yet)

endmenu
```

## esp32_ttl_to_rs485_uart/main/Kconfig
```kconfig
menu "RS485 UART Configuration"

config RS485_UART_PORT
    int "UART Port Number"
    default 1
    range 0 2
    help "UART port used for RS485"

config RS485_UART_TX
    int "UART TX Pin"
    default 17
    help "TX pin for RS485 UART"

config RS485_UART_RX
    int "UART RX Pin"
    default 16
    help "RX pin for RS485 UART"

config RS485_UART_DE
    int "UART RTS / DE Pin"
    default 18
    help "Direction control pin for RS485"

config RS485_UART_RE
    int "UART RTS / RE Pin"
    default 19
    help "Receiver enable pin for RS485 if separate from DE"

config RS485_BAUD_RATE
    int "UART Baud Rate"
    default 115200
    help "Baud rate for RS485 communication"

config SLAVE_ADDRESS
    int "Slave Address"
    default 1
    range 1 255
    help "Unique address of the RS485 slave"

endmenu
```

## sdkconfig.defaults
```kconfig
# --- Display Defaults ---
CONFIG_DISPLAY_PIN_CLK=18
CONFIG_DISPLAY_PIN_MOSI=23
CONFIG_DISPLAY_PIN_CS=5
CONFIG_DISPLAY_PIN_DC=16
CONFIG_DISPLAY_PIN_RST=17

# --- Rotary Encoder Defaults ---
CONFIG_ROTARY_PIN_CLK=22
CONFIG_ROTARY_PIN_DT=19

# --- Buttons Defaults ---
CONFIG_BUTTON_ADC_PIN=4
CONFIG_BUTTON_DEBOUNCE_MS=50
```

## u8g2_test/components/buttons/Kconfig
```kconfig
menu "Button ADC Configuration"

config BUTTON_ADC_PIN
    int "ADC GPIO for Buttons"
    default 4

config BUTTON_DEBOUNCE_MS
    int "Debounce Time (ms)"
    default 50

endmenu
```

## u8g2_test/components/display/Kconfig
```kconfig
menu "Display Configuration"

config DISPLAY_PIN_CLK
    int "SPI CLK Pin"
    default 18

config DISPLAY_PIN_MOSI
    int "SPI MOSI Pin"
    default 23

config DISPLAY_PIN_CS
    int "SPI CS Pin"
    default 5

config DISPLAY_PIN_DC
    int "SPI DC Pin"
    default 16

config DISPLAY_PIN_RST
    int "SPI RST Pin"
    default 17

endmenu
```

## u8g2_test/components/rotary/Kconfig
```kconfig
menu "Rotary Encoder Configuration"

config ROTARY_PIN_CLK
    int "Rotary CLK Pin"
    default 22

config ROTARY_PIN_DT
    int "Rotary DT Pin"
    default 19

endmenu
```
